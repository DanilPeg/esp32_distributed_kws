// hash_kws_master.ino — dedicated 4th ESP32 board that aggregates results
// from three KWS inference nodes (ens_a / ens_b / ens_c) over ESP-NOW.
//
// This board does NOT run a KWS model. It only:
//   * joins ESP-NOW on the same channel as the inference nodes;
//   * decodes HashKwsEspNowPacket (12 int8 logits + label/score/margin);
//   * feeds the logits into hash_ensemble_aggregator (mean_logits by default);
//   * prints `hash_evt kind=fusion ...` so the existing host dashboard keeps
//     working without changes;
//   * blinks the on-board RGB LED with the active aggregator decision colour.
//
// Build:
//   - Board: any ESP32-S3 dev board (no microphone required).
//   - Required sources to add to the sketch (Arduino IDE: Sketch > Add File):
//       code/firmware/hash_kws_aggregator/hash_ensemble_aggregator.cpp
//       code/firmware/hash_kws_aggregator/hash_ensemble_aggregator.h
//       code/firmware/hash_kws_aggregator/aggregator_params.h
//   - Build flags (Tools > "extra flags" or platformio.ini):
//       -DHASH_KWS_ESPNOW_CHANNEL=1   (must match the inference nodes)
//       -DHASH_KWS_AGG_MODE=0          (0=mean_logits, 1=temperature_scaled, 2=learned_weights)
//
// Wire the nodes:
//   - Each inference board flashed with its variant (ens_a / ens_b / ens_c)
//     using code/scripts/select_hash_kws_variant.ps1 and HASH_KWS_NODE_ID
//     in {1, 2, 3} respectively. Channel must equal the master's.

#include <Arduino.h>
#include <WiFi.h>
#include <esp_now.h>
#include <esp_wifi.h>
#include <string.h>

#include "hash_ensemble_aggregator.h"
#include "aggregator_params.h"  // generated by the training notebook

#ifndef HASH_KWS_ESPNOW_CHANNEL
#define HASH_KWS_ESPNOW_CHANNEL 1
#endif
#ifndef HASH_KWS_AGG_NUM_NODES
#define HASH_KWS_AGG_NUM_NODES 3
#endif
#ifndef HASH_KWS_AGG_NUM_CLASSES
#define HASH_KWS_AGG_NUM_CLASSES 12
#endif
#ifndef HASH_KWS_AGG_WINDOW_MS
#define HASH_KWS_AGG_WINDOW_MS 1200
#endif
#ifndef HASH_KWS_AGG_MODE
#define HASH_KWS_AGG_MODE 0  // 0 = mean_logits (recommended per ensemble_results.json)
#endif
#ifndef LED_RGB_PIN
#define LED_RGB_PIN 48
#endif

// Mirror the packet layout from micro_speech.ino — single source of truth must
// match. If the inference firmware changes its struct, update this and rebuild.
constexpr uint32_t kHashKwsEspNowMagic   = 0x4B485731UL;  // "KHW1"
constexpr uint8_t  kHashKwsEspNowVersion = 1;

struct __attribute__((packed)) HashKwsEspNowPacket {
  uint32_t magic;
  uint8_t  version;
  uint8_t  node;
  uint16_t seq;
  uint32_t t_ms;
  uint16_t invoke_ms;
  uint8_t  kind;
  uint8_t  label;
  uint8_t  score;
  uint8_t  margin;
  uint8_t  recent_max;
  uint8_t  flags;
  int8_t   logits[HASH_KWS_AGG_NUM_CLASSES];
  uint16_t crc16;
};

static const char* kCategoryLabels[HASH_KWS_AGG_NUM_CLASSES] = {
  "yes", "no", "up", "down", "left", "right",
  "on", "off", "stop", "go", "unknown", "silence",
};

static hash_kws_ensemble::Aggregator g_aggregator;
static volatile uint32_t g_packets_received = 0;
static volatile uint32_t g_packets_rejected = 0;
static uint32_t g_last_decision_print_ms = 0;
static uint32_t g_last_decision_label = 255;
static const uint32_t kDecisionDedupMs = 800;

static uint16_t HashCrc16(const uint8_t* data, size_t len) {
  uint16_t crc = 0xFFFF;
  for (size_t i = 0; i < len; ++i) {
    crc ^= static_cast<uint16_t>(data[i]);
    for (int bit = 0; bit < 8; ++bit) {
      if ((crc & 1) != 0) {
        crc = static_cast<uint16_t>((crc >> 1) ^ 0xA001);
      } else {
        crc = static_cast<uint16_t>(crc >> 1);
      }
    }
  }
  return crc;
}

static bool ValidatePacket(const HashKwsEspNowPacket& p) {
  if (p.magic != kHashKwsEspNowMagic) return false;
  if (p.version != kHashKwsEspNowVersion) return false;
  if (p.node == 0 || p.node > HASH_KWS_AGG_NUM_NODES) return false;
  if (p.label >= HASH_KWS_AGG_NUM_CLASSES) return false;
  const uint16_t want = HashCrc16(reinterpret_cast<const uint8_t*>(&p),
                                  sizeof(p) - sizeof(p.crc16));
  return p.crc16 == want;
}

static hash_kws_ensemble::SourceKind PacketKindToSource(uint8_t kind) {
  // Mirrors the meaning encoded by micro_speech.ino's emit/episode/infer paths.
  // 0 = infer, 1 = episode, 2 = emit. Anything else collapses to infer.
  using hash_kws_ensemble::SourceKind;
  switch (kind) {
    case 1: return SourceKind::kEpisode;
    case 2: return SourceKind::kEmit;
    default: return SourceKind::kInfer;
  }
}

#if ESP_ARDUINO_VERSION_MAJOR >= 3
static void onDataRecv(const esp_now_recv_info_t* /*info*/,
                       const uint8_t* data, int len) {
#else
static void onDataRecv(const uint8_t* /*mac*/, const uint8_t* data, int len) {
#endif
  if (len != static_cast<int>(sizeof(HashKwsEspNowPacket))) {
    g_packets_rejected++;
    return;
  }
  HashKwsEspNowPacket p;
  memcpy(&p, data, sizeof(p));
  if (!ValidatePacket(p)) {
    g_packets_rejected++;
    return;
  }
  const bool ok = g_aggregator.submit(
      /*node_id=*/p.node,
      /*source=*/PacketKindToSource(p.kind),
      /*device_time_ms=*/p.t_ms,
      /*host_arrival_ms=*/millis(),
      /*logits=*/p.logits,
      /*num_classes=*/HASH_KWS_AGG_NUM_CLASSES);
  if (ok) g_packets_received++;
}

static void rgbForLabel(uint8_t label) {
  // 12-class palette — keep semantically distinct hues on adjacent commands.
  uint8_t r = 0, g = 0, b = 0;
  switch (label) {
    case 0:  r = 0;   g = 64;  b = 0;   break;  // yes
    case 1:  r = 64;  g = 0;   b = 0;   break;  // no
    case 2:  r = 0;   g = 0;   b = 64;  break;  // up
    case 3:  r = 64;  g = 32;  b = 0;   break;  // down
    case 4:  r = 0;   g = 64;  b = 64;  break;  // left
    case 5:  r = 64;  g = 0;   b = 64;  break;  // right
    case 6:  r = 32;  g = 64;  b = 0;   break;  // on
    case 7:  r = 16;  g = 16;  b = 16;  break;  // off
    case 8:  r = 64;  g = 0;   b = 32;  break;  // stop
    case 9:  r = 0;   g = 32;  b = 64;  break;  // go
    case 10: r = 8;   g = 8;   b = 0;   break;  // unknown (dim)
    default: r = 0;   g = 0;   b = 0;   break;  // silence
  }
  neopixelWrite(LED_RGB_PIN, r, g, b);
}

void setup() {
  Serial.begin(115200);
  delay(50);
  Serial.printf("hash_evt kind=boot node=master role=master_aggregator channel=%d agg_mode=%d\n",
                HASH_KWS_ESPNOW_CHANNEL, HASH_KWS_AGG_MODE);

  pinMode(LED_RGB_PIN, OUTPUT);
  rgbForLabel(11);  // silence on boot

  WiFi.mode(WIFI_STA);
  WiFi.disconnect();
  esp_wifi_set_channel(HASH_KWS_ESPNOW_CHANNEL, WIFI_SECOND_CHAN_NONE);
  if (esp_now_init() != ESP_OK) {
    Serial.println("hash_evt kind=espnow phase=init status=fail node=master");
    return;
  }
  esp_now_register_recv_cb(onDataRecv);
  Serial.printf("hash_evt kind=espnow phase=init status=ok node=master mac=%s\n",
                WiFi.macAddress().c_str());

  g_aggregator.reset(HASH_KWS_AGG_NUM_NODES, HASH_KWS_AGG_NUM_CLASSES, HASH_KWS_AGG_WINDOW_MS);
#if HASH_KWS_AGG_MODE == 1
  g_aggregator.setTemperatures(kHashEnsembleTemperatures);
  g_aggregator.setMode(hash_kws_ensemble::Mode::kModeTemperatureScaled);
#elif HASH_KWS_AGG_MODE == 2
  g_aggregator.setLearnedWeights(kHashEnsembleLearnedWeights);
  g_aggregator.setMode(hash_kws_ensemble::Mode::kModeLearnedWeights);
#else
  g_aggregator.setMode(hash_kws_ensemble::Mode::kModeMeanLogits);
#endif
}

void loop() {
  hash_kws_ensemble::Resolved out;
  g_aggregator.resolve(millis(), &out);
  if (out.has_decision) {
    const uint32_t now = millis();
    const bool dedup = (out.label == g_last_decision_label) &&
                       ((now - g_last_decision_print_ms) < kDecisionDedupMs);
    if (!dedup) {
      Serial.printf(
          "hash_evt kind=fusion node=master label=%s score=%d margin=%d voters=%d mode=%d packets=%lu rejected=%lu\n",
          (out.label < HASH_KWS_AGG_NUM_CLASSES) ? kCategoryLabels[out.label] : "?",
          out.score, out.margin, out.num_voters,
          static_cast<int>(out.mode_used),
          static_cast<unsigned long>(g_packets_received),
          static_cast<unsigned long>(g_packets_rejected));
      rgbForLabel(out.label);
      g_last_decision_print_ms = now;
      g_last_decision_label = out.label;
    }
  }
  delay(20);
}
